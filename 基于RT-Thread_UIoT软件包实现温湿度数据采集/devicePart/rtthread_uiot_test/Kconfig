## 基于RT-Thread_UIoT软件包实现温湿度数据采集/devicePart/rtthread_uiot_test/Kconfig
```kconfig
mainmenu "RT-Thread Configuration"

config BSP_DIR
    string
    option env="BSP_ROOT"
    default "."

config RTT_DIR
    string
    option env="RTT_ROOT"
    default "rt-thread"

config PKGS_DIR
    string
    option env="PKGS_ROOT"
    default "packages"

source "$RTT_DIR/Kconfig"
source "$PKGS_DIR/Kconfig"
source "$PKGS_DIR/packages/misc/samples/Kconfig"

config SOC_FAMILY_STM32
    bool

config SOC_SERIES_STM32F7
    bool
    select ARCH_ARM_CORTEX_M7
    select SOC_FAMILY_STM32

config SOC_STM32F767ZITX
    bool
    select SOC_SERIES_STM32F7
    select RT_USING_COMPONENTS_INIT
    select RT_USING_USER_MAIN
    default y
```
